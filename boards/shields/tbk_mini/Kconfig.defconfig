## boards/shields/tbk_mini/Kconfig.defconfig
```kconfig
if SHIELD_TBK_MINI_LEFT

config ZMK_KEYBOARD_NAME
    default "TBK Mini"

config ZMK_SPLIT_ROLE_CENTRAL
    bool
    default y

endif

if SHIELD_TBK_MINI_RIGHT

config ZMK_SPLIT_ROLE_PERIPHERAL
    bool
    default y

endif

if SHIELD_TBK_MINI_LEFT || SHIELD_TBK_MINI_RIGHT

config ZMK_SPLIT
    bool
    default y

if ZMK_DISPLAY

config I2C
    default y

config SSD1306
    default y

endif # ZMK_DISPLAY

endif
```
