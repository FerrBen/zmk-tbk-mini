#include "tbk_mini.dtsi"

/* Shift this half's columns into the 6-11 range of the shared transform. */
&default_transform {
    col-offset = <6>;
};

&kscan0 {
    /* Rows: P0.29, P1.13, P0.10, P0.09 */
    row-gpios
        = <&gpio0 29 (GPIO_ACTIVE_HIGH | GPIO_PULL_DOWN)>
        , <&gpio1 13 (GPIO_ACTIVE_HIGH | GPIO_PULL_DOWN)>
        , <&gpio0 10 (GPIO_ACTIVE_HIGH | GPIO_PULL_DOWN)>
        , <&gpio0 9  (GPIO_ACTIVE_HIGH | GPIO_PULL_DOWN)>
        ;

    /* Cols: P1.06, P1.04, P0.11, P1.00, P0.24, P0.22 */
    col-gpios
        = <&gpio1 6  GPIO_ACTIVE_HIGH>
        , <&gpio1 4  GPIO_ACTIVE_HIGH>
        , <&gpio0 11 GPIO_ACTIVE_HIGH>
        , <&gpio1 0  GPIO_ACTIVE_HIGH>
        , <&gpio0 24 GPIO_ACTIVE_HIGH>
        , <&gpio0 22 GPIO_ACTIVE_HIGH>
        ;
};
